## components/cikon_esp_now/Kconfig
```kconfig
menu "Cikon IoT ESP-NOW"

    config ESPNOW_ENABLE
        bool "Enable ESP-NOW support"
        default n
        help
            Enable ESP-NOW wireless communication protocol.

    config ESPNOW_CHANNEL
        int "WiFi Channel for ESP-NOW"
        depends on ESPNOW_ENABLE
        range 0 14
        default 1
        help
            WiFi channel for ESP-NOW communication.
            Channel 0: Use current WiFi channel
            Channels 1-14: Force specific channel

    config ESPNOW_ENABLE_ENCRYPTION
        bool "Enable ESP-NOW encryption"
        depends on ESPNOW_ENABLE
        default n
        help
            Enable encryption for ESP-NOW messages.

    config ESPNOW_PMK
        string "Primary Master Key (PMK)"
        depends on ESPNOW_ENABLE_ENCRYPTION
        default "pmk1234567890123"
        help
            Primary Master Key for ESP-NOW encryption (must be 16 bytes).

    config ESPNOW_MAX_PEERS
        int "Maximum number of peers"
        depends on ESPNOW_ENABLE
        range 1 20
        default 10
        help
            Maximum number of ESP-NOW peers that can be registered.

endmenu
```

## components/cikon_http/Kconfig
```kconfig
menu "cikon_http"

    config HTTP_PORT
        int "HTTP server port"
        default 8080
        range 1 65535

    config HTTP_ENABLE_WEBDAV
        bool "Enable WebDAV server at /dav/"
        default y
        help
            Registers WebDAV handlers (OPTIONS, PROPFIND, GET, PUT, DELETE,
            MKCOL, MOVE, LOCK, UNLOCK) at the /dav/ prefix. Works over WiFi
            and Thread/IPv6. Compatible with cadaver, curl, rclone, macOS Finder.

    config HTTP_STACK_SIZE
        int "HTTP server task stack size (bytes)"
        default 7168 if HTTP_ENABLE_WEBDAV
        default 5120

    config HTTP_MAX_HANDLERS
        int "Maximum URI handlers"
        default 24 if HTTP_ENABLE_WEBDAV
        default 16
        range 4 64

    config HTTP_CTRL_PORT
        int "HTTP server internal ctrl socket port"
        default 32769
        range 1024 65535

    config HTTP_MAX_OPEN_SOCKETS
        int "Maximum open sockets"
        default 4
        range 1 16

    config HTTP_SESSION_TIMEOUT
        int "Keep-Alive idle timeout (seconds)"
        default 10
        range 2 120
        help
            Sent to the browser as "Keep-Alive: timeout=N". Overrides the browser's
            default (~90 s), causing it to close idle connections sooner and free the
            ~25 KB mbedTLS session buffer. Must be longer than the polling interval
            so active connections are not torn down prematurely.

    config HTTPS_STACK_SIZE
        int "HTTPS server task stack size (bytes)"
        default 10240

    config HTTPS_PORT
        int "HTTPS server port"
        default 443
        range 1 65535

    config HTTPS_CTRL_PORT
        int "HTTPS server internal ctrl socket port"
        default 32769
        range 1024 65535

    config HTTPS_MAX_OPEN_SOCKETS
        int "Maximum open sockets (HTTPS)"
        default 4
        range 1 16

endmenu
```

## components/cikon_https/Kconfig
```kconfig
menu "Cikon IoT HTTPS Server Configuration"

    config HTTPS_TASK_STACK_SIZE
        int "HTTPS server task stack size"
        default 4096
        help
            Stack size for the HTTPS server task in bytes.

    config HTTPS_TASK_PRIORITY
        int "HTTPS server task priority"
        default 2
        range 1 24
        help
            Priority for the HTTPS server task. Higher values indicate higher priority.

    config HTTPS_INACTIVITY_TIMEOUT_MS
        int "HTTPS server inactivity timeout (ms)"
        default 60000
        help
            Time in milliseconds after which the HTTPS server will restart if no requests are received.

    config HTTPS_MAX_OPEN_SOCKETS
        int "Maximum number of open sockets"
        default 1
        range 1 16
        help
            Maximum number of simultaneous connections. Default is 1 for single-connection use.

endmenu
```

## components/cikon_mesh_lite/Kconfig
```kconfig
menu "Mesh Lite Configuration"
    config MESH_LITE_ROUTER_SSID
        string "Router SSID"
        default "mesh_router"
        help
            SSID of the router that root node connects to.

    config MESH_LITE_ROUTER_PASSWORD
        string "Router Password"
        default ""
        help
            Password of the router.
endmenu
```

## components/cikon_mqtt/Kconfig
```kconfig
menu "Cikon IoT MQTT Configuration"
    config MQTT_TELEMETRY_INTERVAL_MS
        int "Telemetry interval (ms)"
        default 5000
        range 1000 60000
        help
            Interval for publishing telemetry data.
            Typical: 5000 (5 sec).

    config MQTT_RX_BUFFER_SIZE
        int "MQTT RX buffer size"
        default 1024
        range 256 8192
        help
            Size of the MQTT receive buffer.
            Typical: 1024.

    config MQTT_QOS
        int "MQTT Quality of Service"
        default 0
        range 0 2
        help
            MQTT Quality of Service level.
            0: At most once (fire and forget)
            1: At least once (acknowledged)
            2: Exactly once (guaranteed delivery)

    config MQTT_COMMAND_TASK_STACK_SIZE
        int "MQTT command task stack size"
        default 4096

    config MQTT_COMMAND_TASK_PRIORITY
        int "MQTT command task priority"
        default 10

    config MQTT_TELEMETRY_TASK_STACK_SIZE
        int "MQTT telemetry task stack size"
        default 4096

    config MQTT_TELEMETRY_TASK_PRIORITY
        int "MQTT telemetry task priority"
        default 5

    config MQTT_ENABLE_HA_DISCOVERY
        bool "Enable Home Assistant MQTT Discovery"
        default y
        help
            Enable Home Assistant auto-discovery protocol.
            When disabled, all HA-related code is removed at compile time.
endmenu
```

## components/cikon_neopixel/Kconfig
```kconfig
menu "Cikon IoT NeoPixel Configuration"

    config NEOPIXEL_GPIO_PIN
        int "NeoPixel GPIO Pin"
        default 35
        help
            GPIO pin connected to the NeoPixel data line.

    config NEOPIXEL_LED_COUNT
        int "Number of LEDs"
        default 1
        range 1 1024
        help
            Total number of LEDs in the strip.

    config NEOPIXEL_DEFAULT_BRIGHTNESS
        int "Default brightness (0-255)"
        default 128
        range 0 255
        help
            Initial brightness applied to all pixels.

    config NEOPIXEL_EFFECTS_TASK_STACK_SIZE
        int "Effects task stack size (bytes)"
        default 3072
        range 2048 8192
        help
            Stack size for the FreeRTOS task running LED effects.
            Increase if effects crash or show stack overflow.
            Rainbow effect requires ~3KB due to HSV conversion and semaphore operations.

    config NEOPIXEL_EFFECTS_TASK_PRIORITY
        int "Effects task priority"
        default 5
        range 1 24
        help
            FreeRTOS priority for the effects task.
            Higher values = higher priority (max 24).

endmenu
```

## components/cikon_rf433_receiver/Kconfig
```kconfig
menu "Cikon IoT RF433 Receiver"

    config RF433_DEBOUNCE_MS
        int "Debounce time in milliseconds"
        default 120
        range 0 500
        help
            Time to ignore duplicate codes after dispatching.
            Prevents multiple triggers from a single button press.

    config CONFIRMATION_WINDOW_MS
        int "Confirmation window in milliseconds"
        default 500
        range 100 2000
        help
            Time window to confirm code reception by receiving the same code again.
            Helps filter out noise and false positives.

    config CONFIRMATION_COUNT
        int "Confirmation count"
        default 2
        range 1 10
        help
            Require consecutive identical frames to filter out noise
            Set to 1 to disable confirmation (fast but noisy)
            Set to 2+ for noise rejection (requires longer button press)

    config RF433_RMT_RESOLUTION_HZ
        int "RMT resolution in Hz"
        default 1000000
        help
            RMT peripheral resolution (typically 1MHz).

    config RF433_RMT_MEM_BLOCK_SYMBOLS
        int "RMT memory block symbols"
        default 64
        range 32 128
        help
            Number of symbols in RMT memory block.

    config RF433_TASK_STACK_SIZE
        int "RF433 receiver task stack size"
        default 3072
        range 2048 8192
        help
            Stack size for the RF433 receiver task.

    config RF433_TASK_PRIORITY
        int "RF433 receiver task priority"
        default 10
        range 1 24
        help
            Priority of the RF433 receiver task.


endmenu
```

## components/cikon_supervisor/Kconfig
```kconfig
menu "Cikon IoT Supervisor Core Configuration"
    config SUPERVISOR_QUEUE_LENGTH
        int "Supervisor command queue length"
        default 8
        range 1 20
        help
            Length of the supervisor command queue.
            Typical: 8.

    config MAX_COMMANDS
        int "Maximum number of commands"
        default 20
        range 1 100
        help
            Maximum number of commands that can be queued for execution.

    config MAX_TELE
        int "Maximum number of telemetry appenders"
        default 20
        range 1 100
        help
            Maximum number of telemetry appenders that can be registered.

    config SUPERVISOR_MAX_ADAPTERS
        int "Maximum number of platform adapters"
        default 8
        range 4 16
        help
            Maximum number of platform adapters that can be registered.
            Typical: 8.

    config SUPERVISOR_TASK_STACK_SIZE
        int "Supervisor task stack size"
        default 4096
        range 2048 8192
        help
            Stack size for the main supervisor task.

    config SUPERVISOR_TASK_PRIORITY
        int "Supervisor task priority"
        default 5
        range 1 24
        help
            Priority of the supervisor task.

    config SUPERVISOR_SAFE_MODE_THRESHOLD
        int "Safe mode crash threshold"
        default 3
        range 2 10
        help
            Number of crashes/panics before activating safe mode.
            Safe mode disables hardware adapters and keeps only WiFi/Monitor/OTA active.

    config SUPERVISOR_SAFE_MODE_STABLE_TIME_S
        int "Safe mode auto-clear time (seconds)"
        default 90
        range 30 300
        help
            Time in seconds of stable operation before auto-clearing safe mode.
            After this time without crashes, boot counter resets to 0.

endmenu
```

## components/cikon_supervisor_adapters/cikon_supervisor_adapters_ds18b20/Kconfig
```kconfig
menu "DS18B20 Temperature Sensor Adapter"

config DS18B20_GPIO
    int "1-Wire GPIO pin"
    default 32
    help
        GPIO pin connected to DS18B20 data line (requires 4.7kΩ pull-up)

config DS18B20_MAX_SENSORS
    int "Maximum number of DS18B20 sensors"
    default 1
    range 1 8
    help
        Maximum number of DS18B20 sensors to scan and register.
        Limited to 8 for memory efficiency.

config DS18B20_SENSOR_NAMES
    string "Sensor names (comma-separated)"
    default "Board Temperature"
    help
        Names for temperature sensors in ROM scan order (sorted by ROM ID).
        Sensors are sorted by ROM ID for deterministic ordering.
        First name = lowest ROM ID, second name = second lowest, etc.
        If fewer names than sensors, remaining get auto-names (temp0, temp1...).

endmenu
```

## components/cikon_supervisor_adapters/cikon_supervisor_adapters_esp_now_rx/Kconfig
```kconfig
menu "ESP-NOW RX Adapter"

    config ESPNOW_RX_AUTO_START
        bool "Auto-start ESP-NOW RX on boot"
        default n
        help
            Automatically start ESP-NOW RX adapter on initialization.
            If disabled, use 'start' command to activate.

endmenu
```

## components/cikon_supervisor_adapters/cikon_supervisor_adapters_inet_mesh/Kconfig
```kconfig
menu "Cikon IoT Supervisor Inet-Mesh Adapter"

    config INET_MESH_MAX_LAYER
        int "Maximum mesh network layers"
        range 1 15
        default 6
        help
            Maximum number of allowed mesh layers in the network.
            Higher values allow deeper networks but may impact performance.
            Range: 1-15 layers

    config INET_MESH_MAX_CONNECTIONS
        int "Maximum child connections per node"
        range 1 10
        default 6
        help
            Maximum number of child nodes that each node can accept.
            Higher values allow more connections but consume more memory.
            Range: 1-10 connections

    config INET_MESH_ENABLE_ROOT_SERVICES
        bool "Enable full services on root node"
        default y
        help
            Enable MQTT, HTTPS, and OTA services when node becomes root.
            Disable if you want minimal root node functionality.

endmenu
```

## components/cikon_supervisor_adapters/cikon_supervisor_adapters_led/Kconfig
```kconfig
menu "Cikon IoT LED Adapter Configuration"

    config LED_ADAPTER_ENABLED
        bool "Enable LED Adapter"
        default y
        help
            Enable LED adapter for PWM control of analog LEDs.

    if LED_ADAPTER_ENABLED

        config LED_GPIO_LIST
            string "LED GPIO List (gpio:name pairs, comma-separated)"
            default "25:Left Strip,27:Right Strip"
            help
                Comma-separated list of GPIO:name pairs for LEDs.
                Format: "gpio:name" or just "gpio" (auto-named as led0, led1, etc.)
                Example: "2:main,4:status,18:alarm" or "2,4,18".
                LEDC channels will be assigned automatically (0, 1, 2, 3...).

        config LED_PWM_FREQUENCY
            int "LED PWM Frequency (Hz)"
            default 20000
            range 100 40000
            help
                PWM frequency for LED control. Higher frequency = smoother dimming.
                Typical values: 1000-10000 Hz.

        config LED_FADE_TIME_MS
            int "Default Fade Time (ms)"
            default 1000
            range 0 5000
            help
                Default fade duration when using led_fade command.

        config LED_OUTPUT_INVERT
            bool "Invert LED Output"
            default n
            help
                Invert PWM output signal (for LEDs connected to VCC instead of GND).
                When enabled: brightness 0 = GPIO HIGH, brightness 255 = GPIO LOW.

    endif

endmenu
```

## components/cikon_supervisor_adapters/cikon_supervisor_adapters_rf433/Kconfig
```kconfig
menu "Cikon IoT Supervisor RF433 Adapter"
    config RF433_GPIO_PIN
        int "RF433 Receiver GPIO Pin"
        default 23 if IDF_TARGET_ESP32
        default 4 if IDF_TARGET_ESP32C3
        default 23
        help
            GPIO pin connected to RF433 receiver data output.
            Default: GPIO23 for ESP32, GPIO4 for ESP32-C3

endmenu
```
