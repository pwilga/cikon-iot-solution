## components/cikon_supervisor_adapters/cikon_supervisor_adapters_thread_br/Kconfig
```kconfig
menu "Thread Border Router Adapter"

    config THREAD_BR_RCP_UART_PORT
        int "UART port number for RCP"
        default 1
        range 0 2

    config THREAD_BR_RCP_TX_PIN
        int "GPIO: S3 TX → RCP RX"
        default 2
        range 0 48

    config THREAD_BR_RCP_RX_PIN
        int "GPIO: S3 RX ← RCP TX"
        default 1
        range 0 48

    config THREAD_BR_RCP_BAUD
        int "UART baud rate for RCP"
        default 460800

    config THREAD_BR_NETWORK_NAME
        string "Thread network name"
        default "cikon-thread"

    config THREAD_BR_CHANNEL
        int "Thread channel (11-26, avoid WiFi ch 1/6/11 overlap)"
        default 15
        range 11 26

    config THREAD_BR_WAKEUP_CHANNEL
        int "Wake-up channel for CSL sleepy devices (0 = same as main channel)"
        default 25
        range 0 26

    config THREAD_BR_PROVISIONED_DATASET
        string "Provisioned dataset hex (from 'ot dataset active -x', empty = generate new)"
        default ""
        help
            Full dataset backup. Used when NVS is empty (e.g. after controller swap).
            Get value by running: ot dataset active -x

endmenu
```

## components/cikon_supervisor_adapters/cikon_supervisor_adapters_thread_device/Kconfig
```kconfig
menu "Thread Device Adapter"
    depends on ENABLE_SUPERVISOR_THREAD_DEVICE

    config THREAD_DEVICE_PROVISIONED_DATASET
        string "Provisioned dataset hex (from 'ot dataset active -x', empty = use NVS)"
        default ""
        help
            Full dataset backup from the Thread network leader.
            Get value by running on any joined device: ot dataset active -x
            Used when NVS is empty (e.g. after factory reset or first boot).

    config THREAD_DEVICE_POLL_PERIOD_MS
        int "SED poll period (ms)"
        default 3000
        range 100 10000
        depends on OPENTHREAD_MTD
        help
            How often the Sleepy End Device polls its parent for queued messages.
            Lower = faster response, higher = better power savings.

endmenu
```

## components/cikon_tcp_monitor/Kconfig
```kconfig
menu "Cikon IoT TCP Monitor Configuration"

        config TCP_MONITOR_TASK_STACK_SIZE
            int "TCP Monitor task stack size"
            default 3072

        config TCP_MONITOR_TASK_PRIORITY
            int "TCP Monitor task priority"
            default 3

        config RING_BUFFER_SIZE
            int "Ring buffer size"
            default 4096
            help
                Size of the ring buffer in bytes.

        config MAX_LOG_SIZE
            int "Maximum log size"
            default 128
            help
                Maximum size of a single log entry (e.g. one ESP_LOG* call) in bytes.
endmenu
```

## components/cikon_tcp_ota/Kconfig
```kconfig
menu "Cikon IoT TCP OTA Configuration"

    config TCP_OTA_PORT
        int "TCP OTA server port"
        default 5555
        range 1024 65535
        help
            TCP port for OTA firmware updates.
            Default: 5555

    config TCP_OTA_TASK_STACK_SIZE
        int "TCP OTA task stack size"
        default 5120
        range 4096 16384
        help
            Stack size (in bytes) for the TCP OTA task.
            OTA operations require significant stack for TLS and flash operations.
            Default: 5120 (increased for TLS + flash ops)

    config TCP_OTA_TASK_PRIORITY
        int "TCP OTA task priority"
        default 4
        range 0 25
        help
            Priority of the TCP OTA task.
            Should be lower than critical system tasks to prevent watchdog timeout.
            Default: 4 (allows IDLE task to run during flash erase)

endmenu
```

## components/cikon_thread_common/Kconfig
```kconfig
menu "Thread Common - Radio"

    config THREAD_RADIO_RCP_UART_PORT
        int "UART port number for RCP"
        depends on OPENTHREAD_RADIO_SPINEL_UART
        default 1
        range 0 2

    config THREAD_RADIO_RCP_TX_PIN
        int "GPIO: host TX → RCP RX"
        depends on OPENTHREAD_RADIO_SPINEL_UART
        default 2
        range 0 48

    config THREAD_RADIO_RCP_RX_PIN
        int "GPIO: host RX ← RCP TX"
        depends on OPENTHREAD_RADIO_SPINEL_UART
        default 1
        range 0 48

    config THREAD_RADIO_RCP_BAUD
        int "UART baud rate for RCP"
        depends on OPENTHREAD_RADIO_SPINEL_UART
        default 460800

endmenu
```
