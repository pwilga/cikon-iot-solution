## components/cikon_certs/Kconfig
```kconfig
menu "Certificate Loader"

    config CERTS_DIR
        string "Directory for TLS certificates on LittleFS"
        default "/data/certs"

    config CERT_CA_FILENAME
        string "CA certificate filename"
        default "ca.pem"

    config CERT_CLIENT_FILENAME
        string "Client certificate filename"
        default "client.pem"

    config CERT_CLIENT_KEY_FILENAME
        string "Client private key filename"
        default "client.key"

endmenu
```

## components/cikon_core/Kconfig
```kconfig
menu "Cikon IoT Board Configuration"
    config VFS_EVENTFD_MAX_FDS
        int "Max eventfd file descriptors (0 = disabled)"
        default 0
        range 0 16
        help
            Register esp_vfs_eventfd at platform init with this many fds.
            Set > 0 when using OpenThread (needs ~4: netif, task queue,
            border router, spinel). Can only be registered once globally.

    config VFS_LITTLEFS_ENABLED
        bool "Mount LittleFS partition at boot"
        default n

    config VFS_LITTLEFS_MOUNT_POINT
        string "Mount point"
        default "/data"
        depends on VFS_LITTLEFS_ENABLED

    config VFS_LITTLEFS_PARTITION
        string "Partition label"
        default "littlefs"
        depends on VFS_LITTLEFS_ENABLED

    config VFS_SPIFFS_ENABLED
        bool "Mount SPIFFS partition at boot"
        default n

    config VFS_SPIFFS_MOUNT_POINT
        string "Mount point"
        default "/spiffs"
        depends on VFS_SPIFFS_ENABLED

    config VFS_SPIFFS_PARTITION
        string "Partition label"
        default "web_storage"
        depends on VFS_SPIFFS_ENABLED

    config RESTART_MAX_CALLBACKS
        int "Maximum number of restart callbacks"
        default 4
        range 2 8
        help
            Maximum number of callbacks that can register via register_restart_callback()
            to run before esp_safe_restart() resets the device.

endmenu
```

## components/cikon_ethernet/Kconfig
```kconfig
menu "Cikon Ethernet Hardware"

choice ETHERNET_HARDWARE
    prompt "Ethernet Backend"
    default ETHERNET_W5500
    help
        Select the physical Ethernet hardware to use.

config ETHERNET_W5500
    bool "W5500 (SPI)"
    help
        WIZnet W5500 SPI Ethernet controller with integrated MAC+PHY+TCP/IP stack.
        Requires SPI interface (MOSI/MISO/SCK/CS/INT pins).

config ETHERNET_ESP_EMAC
    bool "ESP32-P4 Internal EMAC + External PHY"
    help
        ESP32-P4 built-in Ethernet MAC (esp_eth_mac_new_esp32) with external PHY chip.
        Uses the RMII interface. Data-plane pins follow the ESP32-P4 IO_MUX defaults
        (matching e.g. the M5Stack Unit PoE-P4).

        NOTE: This is the real-silicon EMAC, not the QEMU-only OpenCores MAC.

endchoice

if ETHERNET_W5500
    menu "W5500 SPI Configuration"
        config W5500_SPI_HOST
            int "SPI Host"
            default 2
            range 1 3
            help
                SPI peripheral to use (SPI2 or SPI3).
                SPI1 is reserved for flash.

        config W5500_SPI_CLOCK_MHZ
            int "SPI Clock Speed (MHz)"
            default 40
            range 1 80
            help
                SPI clock frequency in MHz. W5500 supports up to 80MHz.

        config W5500_SPI_SCLK_GPIO
            int "SPI SCLK GPIO"
            default 5

        config W5500_SPI_MOSI_GPIO
            int "SPI MOSI GPIO"
            default 8

        config W5500_SPI_MISO_GPIO
            int "SPI MISO GPIO"
            default 7

        config W5500_SPI_CS_GPIO
            int "SPI CS GPIO"
            default 6

        config W5500_INT_GPIO
            int "Interrupt GPIO (-1 = polling mode)"
            default -1
            help
                Set to -1 to use polling mode instead.

        config W5500_POLLING_MS
            int "Polling Interval (ms) if no interrupt"
            default 5
            range 1 10000
            depends on W5500_INT_GPIO < 0

        config W5500_PHY_RST_GPIO
            int "PHY Reset GPIO (-1 = no reset)"
            default -1

        config W5500_PHY_ADDR
            int "PHY Address"
            default 1
            range 0 31
    endmenu
endif

if ETHERNET_ESP_EMAC
    choice ETHERNET_PHY
        prompt "External PHY Chip"
        default ETHERNET_PHY_IP101
        help
            Select the physical Ethernet PHY chip connected to ESP32-P4 MAC.

    config ETHERNET_PHY_IP101
        bool "IP101 (e.g., M5Stack PoE-P4)"
        help
            IC Plus IP101GRI Ethernet PHY.

    config ETHERNET_PHY_GENERIC
        bool "Generic IEEE 802.3 PHY"
        help
            Auto-detect any standard-compliant Ethernet PHY.
    endchoice

    menu "PHY Configuration"
        config ETHERNET_PHY_ADDR
            int "PHY Address (SMI/MDIO)"
            default 1
            range 0 31

        config ETHERNET_PHY_RST_GPIO
            int "PHY Reset GPIO (-1 = no reset)"
            default -1
    endmenu
endif

endmenu
```

## components/cikon_light/Kconfig
```kconfig
menu "Cikon IoT Light Driver"

    # Which lights this device drives is not configured here: it lives in the device profile, as
    # devices/<profile>/config/cikon_light/lights.toml, and becomes a C table at build time. Pins
    # are wiring rather than a setting, and a mistake in them should fail the build.

    config LIGHT_PWM_FREQUENCY
        int "PWM frequency (Hz)"
        default 20000
        range 100 40000
        help
            PWM frequency for light channels (LEDC). Default is at the edge of human
            hearing to avoid audible coil/driver whine at lower frequencies.

    config LIGHT_ENABLE_FADE
        bool "Enable smooth fade transitions"
        default y
        help
            Use LEDC hardware fade for color/brightness/CCT transitions instead of
            snapping to the new value immediately.

    if LIGHT_ENABLE_FADE

        config LIGHT_FADE_TIME_MS
            int "Default fade time (ms)"
            default 200
            range 0 5000
            help
                Default fade duration for color/brightness/CCT transitions.

    endif

    config LIGHT_PERSIST_STATE
        bool "Persist light state across reboots (NVS)"
        default y
        help
            Save brightness/color/CCT to NVS and restore on boot. On/off is only
            restored after a planned restart (cmnd restart/OTA/resetconf) -
            after power loss/panic/watchdog the light stays off.

    config LIGHT_ENABLE_EFFECTS
        bool "Enable addressable strip animation effects"
        default y
        help
            Dedicated FreeRTOS task driving time-based animations on addressable
            (WS2812/SK6812, role N) lights. The task sleeps fully blocked (zero
            CPU) whenever no light is animating, but still permanently reserves
            its stack (~3-4KB RAM) once the device boots. Can be set to n for a
            device with a strip that only ever wants a fixed color, to pay
            nothing extra - light.c then behaves exactly as it does today.
            No effect on pure PWM lights - only compiled in when a role-N
            channel is also configured in LIGHT_GPIO_LIST.

    if LIGHT_ENABLE_EFFECTS

        config LIGHT_EFFECTS_TASK_PRIORITY
            int "Addressable effects task priority"
            default 4
            range 0 24
            help
                Priority of the FreeRTOS task rendering addressable-strip
                animations. Keep it just below the supervisor task
                (CONFIG_SUPERVISOR_TASK_PRIORITY, default 5) so telemetry and
                command dispatch stay responsive while an effect runs. The
                default of 4 is the value this task ran at when it derived its
                priority from the supervisor's directly.

        config LIGHT_EFFECTS_FPS
            int "Addressable effects animation frame rate"
            default 60
            range 10 120
            help
                Target frame rate for the effects task. WLED's field-proven
                default is 42 (WLED_FPS in their FX.h), used across their whole
                install base from a handful of LEDs to many hundreds - a
                comfortable margin even there. 60 has more headroom for our
                current (short, 30-LED) strips; adjust down for a device with a
                much longer strip (led_strip_refresh time scales with LED count).

    endif

endmenu
```

## components/cikon_supervisor_adapters/cikon_supervisor_adapters_button/Kconfig
```kconfig
menu "Cikon IoT Supervisor Button Adapter"
    config BUTTON_MAX_COUNT
        int "Maximum number of buttons"
        default 4
        range 1 16
        help
            Maximum number of buttons that can be configured.
            Adjust based on available GPIOs and memory constraints.

    config BUTTON_GPIO_LIST
        string "Button GPIO List (gpio:active_level[:name] tuples, comma-separated)"
        default "0:0"
        help
            Comma-separated list of GPIO:active_level:name entries for buttons.
            Format: "gpio:active_level" or "gpio:active_level:name".
            active_level is 0 (LOW) or 1 (HIGH). name is optional and free-form
            (auto-named as "gpio<N>" if omitted, e.g. "gpio18").
            Example: "0:0,9:0" for two unnamed buttons.
            Example: "18:0:switch_a,19:0:switch_b" for two named buttons.

endmenu
```

## components/cikon_supervisor_adapters/cikon_supervisor_adapters_debug/Kconfig
```kconfig
menu "Cikon IoT Debug Adapter"

    config DEBUG_CONSOLE
        bool "Interactive console on the serial port"
        depends on ENABLE_SUPERVISOR_DEBUG
        default n
        help
            Starts an esp_console REPL on the console port, with the device name as the prompt.

endmenu
```

## components/cikon_supervisor_adapters/cikon_supervisor_adapters_led_indicator/Kconfig
```kconfig
menu "Cikon IoT Supervisor LED Indicator Adapter"

    choice
        prompt "LED indicator type"
        default LED_INDICATOR_NEOPIXEL
        help
            Hardware type of the status LED driven by this adapter.

        config LED_INDICATOR_NEOPIXEL
            bool "Addressable (SK6812/WS2812, single-wire RMT)"
        config LED_INDICATOR_RGB
            bool "Analog RGB (3-pin, LEDC/PWM)"
    endchoice

    config LED_INDICATOR_NEOPIXEL_GPIO
        int "Neopixel data GPIO number"
        depends on LED_INDICATOR_NEOPIXEL
        default 35
        range 0 48
        help
            GPIO pin connected to the addressable status LED (SK6812/WS2812).
            For AtomS3 Lite: GPIO 35 (built-in RGB LED).

    config LED_INDICATOR_RGB_GPIO_RED
        int "RGB red channel GPIO number"
        depends on LED_INDICATOR_RGB
        default 17
        range 0 48
        help
            GPIO pin driving the red channel of the analog RGB LED.
            For M5Stack Unit PoE-P4: GPIO 17.

    config LED_INDICATOR_RGB_GPIO_GREEN
        int "RGB green channel GPIO number"
        depends on LED_INDICATOR_RGB
        default 15
        range 0 48
        help
            GPIO pin driving the green channel of the analog RGB LED.
            For M5Stack Unit PoE-P4: GPIO 15.

    config LED_INDICATOR_RGB_GPIO_BLUE
        int "RGB blue channel GPIO number"
        depends on LED_INDICATOR_RGB
        default 16
        range 0 48
        help
            GPIO pin driving the blue channel of the analog RGB LED.
            For M5Stack Unit PoE-P4: GPIO 16.

    config LED_INDICATOR_RGB_ACTIVE_HIGH
        bool "RGB LED is active-high"
        depends on LED_INDICATOR_RGB
        default n
        help
            Set y for common-cathode LEDs (GPIO high = channel ON), n for
            common-anode LEDs (GPIO low = channel ON).
            M5Stack Unit PoE-P4 uses a common-anode LED (active-low) -> n.

    config LED_INDICATOR_BRIGHTNESS
        int "LED Indicator brightness (0-255)"
        default 255 if LED_INDICATOR_RGB
        default 90
        range 0 255
        help
            Global brightness for all LED effects.
            0 = off, 255 = full brightness.
            Analog RGB defaults to max: it is much dimmer than an SK6812
            (green/blue Vf leaves little headroom off 3.3V, so the green die
            is weak), and there is no per-channel gain to compensate.
endmenu
```
