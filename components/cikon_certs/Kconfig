## components/cikon_supervisor_adapters/cikon_supervisor_adapters_light/Kconfig
```kconfig
menu "Cikon IoT Supervisor Light Adapter"

    config LIGHT_MAX_COUNT
        int "Maximum number of lights"
        default 6
        range 1 8
        help
            Maximum number of logical "light" entities. Each light is one physical
            fixture (1-5 GPIO channels: Red/Green/Blue/Cold-white/Warm-white, or a
            single plain on/off relay/switch channel).

    config LIGHT_GPIO_LIST
        string "Light channel list (role+gpio pairs per light, comma-separated)"
        default "R17+G21+B16+C18+W19:Color Strip,W25:Left Strip,W27:Right Strip"
        help
            Comma-separated list of lights. Each light is a '+'-joined set of
            <role><gpio> channel tokens, optionally followed by ":name".

            Roles:
              - R = red
              - G = green
              - B = blue
              - C = cold-white
              - W = warm-white
              - S = plain on/off relay/switch (no PWM/brightness/color)
              - N = addressable strip (WS2812/SK6812), solid color only -
                    exclusive, cannot combine with any other role

            Supported role sets (one token per role):
              - C | W | CW                (white / CCT only)
              - RGB | RGBC | RGBW | RGBCW (color, optionally + white)
              - S                         (on/off only - cannot combine
                                            with any other role)
              - N                         (addressable strip - cannot combine
                                            with any other role)

            S active-level suffix (appended directly to the GPIO number,
            not ':'-separated - ':' is reserved for the trailing light
            name):
              - S<gpio>   -> active-high (default)
              - S<gpio>H  -> active-high (explicit)
              - S<gpio>L  -> active-low

            N<gpio>x<count>[<format>] suffix (LED count is required; color
            format is optional, defaults to grb):
              - N<gpio>x<count>       -> WS2812, GRB order (most common)
              - N<gpio>x<count>rgb    -> WS2812, RGB order
              - N<gpio>x<count>grbw   -> SK6812, GRB + separate white
              - N<gpio>x<count>rgbw   -> SK6812, RGB + separate white
            Even "plain" WS2812 strips vary in channel order between
            batches/clones - grb is a starting guess to verify on the actual
            strip (send a known color and check it comes out right), not a
            given.

            Example:
              "R17+G21+B16+C18+W19:Color Strip,W25:Left Strip,S26L:Porch Bulb,N4x30:Tree"

    config LIGHT_PWM_FREQUENCY
        int "PWM frequency (Hz)"
        default 20000
        range 100 40000
        help
            PWM frequency for light channels (LEDC). Default is at the edge of human
            hearing to avoid audible coil/driver whine at lower frequencies.

    config LIGHT_ENABLE_FADE
        bool "Enable smooth fade transitions"
        default y
        help
            Use LEDC hardware fade for color/brightness/CCT transitions instead of
            snapping to the new value immediately.

    if LIGHT_ENABLE_FADE

        config LIGHT_FADE_TIME_MS
            int "Default fade time (ms)"
            default 200
            range 0 5000
            help
                Default fade duration for color/brightness/CCT transitions.

    endif

    config LIGHT_PERSIST_STATE
        bool "Persist light state across reboots (NVS)"
        default y
        help
            Save brightness/color/CCT to NVS and restore on boot. On/off is only
            restored after a planned restart (cmnd restart/OTA/resetconf) -
            after power loss/panic/watchdog the light stays off.

    config LIGHT_ENABLE_EFFECTS
        bool "Enable addressable strip animation effects"
        default y
        help
            Dedicated FreeRTOS task driving time-based animations on addressable
            (WS2812/SK6812, role N) lights. The task sleeps fully blocked (zero
            CPU) whenever no light is animating, but still permanently reserves
            its stack (~3-4KB RAM) once the device boots. Can be set to n for a
            device with a strip that only ever wants a fixed color, to pay
            nothing extra - light.c then behaves exactly as it does today.
            No effect on pure PWM lights - only compiled in when a role-N
            channel is also configured in LIGHT_GPIO_LIST.

    if LIGHT_ENABLE_EFFECTS

        config LIGHT_EFFECTS_FPS
            int "Addressable effects animation frame rate"
            default 60
            range 10 120
            help
                Target frame rate for the effects task. WLED's field-proven
                default is 42 (WLED_FPS in their FX.h), used across their whole
                install base from a handful of LEDs to many hundreds - a
                comfortable margin even there. 60 has more headroom for our
                current (short, 30-LED) strips; adjust down for a device with a
                much longer strip (led_strip_refresh time scales with LED count).

    endif

endmenu
```

## components/cikon_supervisor_adapters/cikon_supervisor_adapters_network/Kconfig
```kconfig
menu "Cikon IoT Supervisor Network Adapter"
    depends on ENABLE_SUPERVISOR_NETWORK

    config NETWORK_UPLINK_WIFI
        bool "WiFi uplink"
        default y if !NETWORK_UPLINK_ETHERNET && !NETWORK_UPLINK_THREAD
        help
            Bring the device onto the network over WiFi (STA, with AP mode for local access).
            The uplink a device has when it names none (uplink: in its network.yaml).

    config NETWORK_UPLINK_ETHERNET
        bool "Ethernet uplink"
        default n
        help
            Bring the device onto the network over Ethernet (hardware selected in cikon_ethernet).
            Takes precedence over Thread and WiFi when several are enabled - only one uplink starts.

    config NETWORK_UPLINK_THREAD
        bool "Thread uplink"
        default n
        help
            Bring the device onto the network over Thread (FTD/MED, joins an existing network).
            Takes precedence over WiFi when both are enabled.
            Not for the border router (it runs Thread itself).
            Turns on what Thread needs (see Kconfig.projbuild).
            The network key comes from a commissioner (ot joiner start <PSKd>), not from the build.

endmenu
```

## components/cikon_supervisor_adapters/cikon_supervisor_adapters_switch/Kconfig
```kconfig
menu "Cikon IoT Supervisor Switch Adapter"
    config SWITCH_MAX_COUNT
        int "Maximum number of switches"
        default 4
        range 1 16
        help
            Maximum number of digital outputs that can be configured.
            Adjust based on available GPIOs and memory constraints.

    config SWITCH_GPIO_LIST
        string "Switch GPIO List (gpio:active_level[:name] tuples, comma-separated)"
        default "0:1"
        help
            Comma-separated list of GPIO:active_level:name entries for digital outputs
            (relays, plain LEDs, valves, buzzers - anything that's just on/off).
            Format: "gpio:active_level" or "gpio:active_level:name".
            active_level is 0 (LOW) or 1 (HIGH) - the physical level that means "on".
            name is optional and free-form (auto-named as "gpio<N>" if omitted).
            Example: "14:1:ceiling_relay,27:0:garden_valve".

endmenu
```

## components/cikon_supervisor_adapters/cikon_supervisor_adapters_thread_border_router/Kconfig
```kconfig
menu "Cikon IoT Supervisor Thread Border Router Adapter"

    config THREAD_BORDER_ROUTER_NETWORK_NAME
        string "Thread network name"
        default "cikon-thread"

    config THREAD_BORDER_ROUTER_CHANNEL
        int "Thread channel (11-26, avoid WiFi ch 1/6/11 overlap)"
        default 15
        range 11 26

    config THREAD_BORDER_ROUTER_WAKEUP_CHANNEL
        int "Wake-up channel for CSL sleepy devices (0 = same as main channel)"
        default 25
        range 0 26

    config THREAD_BORDER_ROUTER_WEB
        bool "Enable Thread Border Router Web GUI"
        default n
        imply VFS_SPIFFS_ENABLED
        help
            Start the ot-br-posix REST API + HTML/JS frontend on port 80.
            Turns on SPIFFS; needs the web_storage partition.

endmenu
```

## components/cikon_thread/Kconfig
```kconfig
menu "Cikon IoT Thread Radio Configuration"

    config THREAD_RADIO_RCP_UART_PORT
        int "UART port number for RCP"
        depends on OPENTHREAD_RADIO_SPINEL_UART
        default 1
        range 0 2

    config THREAD_RADIO_RCP_TX_PIN
        int "GPIO: host TX → RCP RX"
        depends on OPENTHREAD_RADIO_SPINEL_UART
        default 2
        range 0 48

    config THREAD_RADIO_RCP_RX_PIN
        int "GPIO: host RX ← RCP TX"
        depends on OPENTHREAD_RADIO_SPINEL_UART
        default 1
        range 0 48

    config THREAD_RADIO_RCP_BAUD
        int "UART baud rate for RCP"
        depends on OPENTHREAD_RADIO_SPINEL_UART
        default 460800

    config THREAD_TELE_COUNTERS
        bool "Counters and link quality in the Thread tele"
        default y
        help
            Adds the objects mac, mle, ip, buffers (and br on a border router) and the RSSI of the
            parent to the tele "thread": frames sent and received, retries and failed channel
            checks, the message buffer pool. Building the tele takes a few KB of heap for a moment,
            so a device short on memory can leave it out.

endmenu
```

## components/cikon_wifi/Kconfig
```kconfig
menu "Cikon IoT WiFi Configuration"
    config WIFI_AP_INACTIVITY_TIMEOUT_MINUTES
        int "WiFi AP inactivity timeout (minutes)"
        default 10
        range 1 60
        help
            Timeout in minutes before disabling AP if no clients are connected.

    config WIFI_STA_RETRY_INITIAL_MS
        int "WiFi STA retry initial interval (ms)"
        default 60000
        range 1000 600000
        help
            Initial delay before retrying WiFi STA connection after a burst of failed attempts.
            Used for exponential backoff. Typical: 60000 (1 min).

    config WIFI_STA_RETRY_MAX_MS
        int "WiFi STA retry maximum interval (ms)"
        default 600000
        range 1000 3600000
        help
            Maximum delay between WiFi STA connection retry bursts (exponential backoff upper limit).
            Typical: 600000 (10 min).

    config WIFI_STA_BURST_RETRY_COUNT
        int "WiFi STA burst retry count"
        default 5
        range 1 20
        help
            Number of immediate retry attempts in a burst before increasing the retry interval.
            Typical: 5.

    config WIFI_STA_BURST_RETRY_DELAY_MS
        int "WiFi STA burst retry delay (ms)"
        default 10000
        range 100 60000
        help
            Delay between individual attempts within a burst of WiFi STA connection retries.
            Typical: 10000 (10 sec).


endmenu
```
